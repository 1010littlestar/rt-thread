## bsp/stm32/stm32f765-cuav-v5+/board/Kconfig
```kconfig
menu "Hardware Drivers Config"

config SOC_STM32F765IIKx
    bool
    select SOC_SERIES_STM32F7
    select RT_USING_COMPONENTS_INIT
    select RT_USING_USER_MAIN
    default y

menu "Onboard Peripheral Drivers"

	config BSP_USING_SDCARD
			bool "Enable SDCARD (sdio)"
			select BSP_USING_SDIO
			select RT_USING_DFS
			select RT_USING_DFS_ELMFAT
			default n

endmenu

menu "On-chip Peripheral Drivers"

    config BSP_USING_GPIO
        bool "Enable GPIO"
        select RT_USING_PIN
        default y

    menuconfig BSP_USING_UART
        bool "Enable UART"
        default n
        select RT_USING_SERIAL
        if BSP_USING_UART
            menuconfig BSP_USING_UART7
                bool "Enable UART7 (Debuger)"
                default n
			if BSP_USING_UART7
                config BSP_UART7_RX_USING_DMA
                    bool "Enable UART7 RX DMA"
                    depends on BSP_USING_UART1 && RT_SERIAL_USING_DMA
                    default n
			endif
			
			menuconfig BSP_USING_UART2
                bool "Enable UART2(TELEM1)"
                default n
			if BSP_USING_UART2
                config BSP_UART2_RX_USING_DMA
                    bool "Enable UART2 RX DMA"
                    depends on BSP_USING_UART2 && RT_SERIAL_USING_DMA
                    default n
			endif
			
			menuconfig BSP_USING_UART3
                bool "Enable UART3(TELEM2)"
                default n
			if BSP_USING_UART3
                config BSP_UART3_RX_USING_DMA
                    bool "Enable UART3 RX DMA"
                    depends on BSP_USING_UART3 && RT_SERIAL_USING_DMA
                    default n
			endif
			
			
			menuconfig BSP_USING_UART4
                bool "Enable UART4"
                default n
			if BSP_USING_UART4
                config BSP_UART4_RX_USING_DMA
                    bool "Enable UART4 RX DMA"
                    depends on BSP_USING_UART4 && RT_SERIAL_USING_DMA
                    default n
			endif
			
        endif
		
	menuconfig BSP_USING_I2C
        bool "Enable I2C Bus"
        default n
        select RT_USING_I2C
        select RT_USING_I2C_BITOPS
        select RT_USING_PIN
        if BSP_USING_I2C
            config BSP_USING_I2C1
                bool "Enable I2C1 Bus (User I2C)"
				default n
			    if BSP_USING_I2C1
                    comment "Notice: PB8 --> 24; PB9 --> 25" 
                    config BSP_I2C1_SCL_PIN
                        int "i2c1 SCL pin number"
                        range 1 176
                        default 24
                    config BSP_I2C1_SDA_PIN
                        int "i2c1 SDA pin number"
                        range 1 176
                        default 25
                endif
            config BSP_USING_I2C2
                bool "Enable I2C2 Bus (User I2C)"
                default n
				if BSP_USING_I2C2
                    comment "Notice:  PF1 --> 81; PF0 --> 80" 
                    config BSP_I2C2_SCL_PIN
                        int "i2c2 SCL pin number"
                        range 1 176
                        default 81
                    config BSP_I2C2_SDA_PIN
                        int "i2c2 SDA pin number"
                        range 1 176
                        default 80
                endif
			config BSP_USING_I2C3
                bool "Enable I2C3 Bus (User I2C)"
                default n
				if BSP_USING_I2C3
                    comment "Notice:  PH7 --> 119; PH8 --> 120" 
                    config BSP_I2C3_SCL_PIN
                        int "i2c3 SCL pin number"
                        range 1 176
                        default 119
                    config BSP_I2C3_SDA_PIN
                        int "i2c3 SDA pin number"
                        range 1 176
                        default 120
                endif
			config BSP_USING_I2C4
                bool "Enable I2C4 Bus (User I2C)"
                default n
				if BSP_USING_I2C4
                    comment "Notice:  PF14 --> 94; PF15 --> 95" 
                    config BSP_I2C4_SCL_PIN
                        int "i2c4 SCL pin number"
                        range 1 176
                        default 94
                    config BSP_I2C4_SDA_PIN
                        int "i2c4 SDA pin number"
                        range 1 176
                        default 95
                endif
        endif
	menuconfig BSP_USING_CAN
        bool "Enable CAN"
        default n
        select RT_USING_CAN
        if BSP_USING_CAN
            config BSP_USING_CAN1
                bool "using CAN1"
                default n
			config BSP_USING_CAN2
                bool "using CAN2"
                default n
        endif	
		
	menuconfig BSP_USING_SPI
        bool "Enable SPI"
        default n
		select RT_USING_SPI
        if BSP_USING_SPI
            config BSP_USING_SPI5
                bool "Enable SPI5 BUS"
                default n
        endif
		
    config BSP_USING_SDIO
        bool "Enable SDIO"
        select RT_USING_SDIO
        select RT_USING_DFS
        default n
		
	menuconfig BSP_USING_ADC
        bool "Enable ADC"
        default n
        select RT_USING_ADC
        if BSP_USING_ADC
            config BSP_USING_ADC1
                bool "Enable ADC1"
                default n
        endif
		
    menuconfig BSP_USING_ONCHIP_RTC
        bool "Enable RTC"
        select RT_USING_RTC
        select RT_USING_LIBC
        default n
        if BSP_USING_ONCHIP_RTC             
            choice                            
                prompt "Select clock source"  
                default BSP_RTC_USING_LSE     

                config BSP_RTC_USING_LSE      
                    bool "RTC USING LSE"

                config BSP_RTC_USING_LSI
                    bool "RTC USING LSI"
            endchoice                      
        endif
		
    config BSP_USING_USBD
        bool "Enable USB Device"
        select RT_USING_USB_DEVICE
        default n
		
	menuconfig BSP_USING_PWM
		bool "Enable PWM"
		default n
		select RT_USING_PWM
		if BSP_USING_PWM
			menuconfig BSP_USING_PWM1
				bool "Enable timer1 output pwm"
				default n
				if BSP_USING_PWM1
					config BSP_USING_PWM1_CH1
						bool "Enable PWM1 channel1"
						default n

					config BSP_USING_PWM1_CH2
						bool "Enable PWM1 channel2"
						default n
					
					config BSP_USING_PWM1_CH3
						bool "Enable PWM1 channel3"
						default n

					config BSP_USING_PWM1_CH4
						bool "Enable PWM1 channel4"
						default n				
				endif		
		
		
			menuconfig BSP_USING_PWM2
				bool "Enable timer2 output pwm"
				default n
				if BSP_USING_PWM2
					config BSP_USING_PWM2_CH1
						bool "Enable PWM2 channel1"
						default n

					config BSP_USING_PWM2_CH2
						bool "Enable PWM2 channel2"
						default n
					
					config BSP_USING_PWM2_CH3
						bool "Enable PWM2 channel3"
						default n

					config BSP_USING_PWM2_CH4
						bool "Enable PWM2 channel4"
						default n				
				endif
			
			menuconfig BSP_USING_PWM3
				bool "Enable timer3 output pwm"
				default n
				if BSP_USING_PWM3
					config BSP_USING_PWM3_CH1
					bool "Enable PWM3 channel1"
					default n

					config BSP_USING_PWM3_CH2
					bool "Enable PWM3 channel2"
					default n

					config BSP_USING_PWM3_CH4
					bool "Enable PWM3 channel4"
					default n				
				endif	

			menuconfig BSP_USING_PWM4
				bool "Enable timer4 output pwm"
				default n
				if BSP_USING_PWM4
					config BSP_USING_PWM4_CH2
						bool "Enable PWM4 channel2"
						default n
					
					config BSP_USING_PWM4_CH3
						bool "Enable PWM4 channel3"
						default n			
				endif

			menuconfig BSP_USING_PWM5
				bool "Enable timer5 output pwm"
				default n
				if BSP_USING_PWM5
					config BSP_USING_PWM5_CH1
						bool "Enable PWM5 channel1"
						default n				
				
					config BSP_USING_PWM5_CH2
						bool "Enable PWM5 channel2"
						default n
					
					config BSP_USING_PWM5_CH3
						bool "Enable PWM5 channel3"
						default n			
				endif		

			menuconfig BSP_USING_PWM8
				bool "Enable timer8 output pwm"
				default n
				if BSP_USING_PWM8
					config BSP_USING_PWM8_CH1
						bool "Enable PWM8 channel1"
						default n						
				endif	

			menuconfig BSP_USING_PWM9
				bool "Enable timer9 output pwm"
				default n
				if BSP_USING_PWM9
					config BSP_USING_PWM9_CH1
						bool "Enable PWM9 channel1"
						default n						
				endif	

			menuconfig BSP_USING_PWM12
				bool "Enable timer12 output pwm"
				default n
				if BSP_USING_PWM12
					config BSP_USING_PWM12_CH1
						bool "Enable PWM12 channel1"
						default n	

					config BSP_USING_PWM12_CH2
						bool "Enable PWM12 channel2"
						default n							
				endif

			menuconfig BSP_USING_PWM14
				bool "Enable timer14 output pwm"
				default n
				if BSP_USING_PWM14
					config BSP_USING_PWM14_CH1
						bool "Enable PWM14 channel1"
						default n						
				endif				
				
		endif	
		

    source "../libraries/HAL_Drivers/Kconfig"
    
endmenu

menu "Board extended module Drivers"

endmenu
 
endmenu
```
